#include "ssd1306.h"
#include "battery.h"
#include "driver/i2c_master.h"
#include "esp_log.h"
#include "freertos/FreeRTOS.h"
#include "freertos/task.h"
#include <string.h>
#include <stdio.h>

static const char *TAG = "ssd1306";

#define I2C_MASTER_NUM I2C_NUM_0
#define I2C_MASTER_SDA_IO 23
#define I2C_MASTER_SCL_IO 24
#define I2C_MASTER_FREQ_HZ 400000
#define OLED_ADDR 0x3C

static uint8_t fb[8][128];
static bool page_dirty[8];
static i2c_master_dev_handle_t dev_handle;

static const uint8_t font8x8[96][8] = {
    {0x00,0x00,0x00,0x00,0x00,0x00,0x00,0x00},
    {0x00,0x00,0x5F,0x00,0x00,0x00,0x00,0x00},
    {0x00,0x07,0x00,0x07,0x00,0x00,0x00,0x00},
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    {0x10,0x08,0x10,0x08,0x00,0x00,0x00,0x00},
};

static void oled_send_cmds(const uint8_t *cmds, size_t len) {
    uint8_t buf[64];
    if (len + 1 > sizeof(buf)) return;
    buf[0] = 0x00;
    memcpy(buf + 1, cmds, len);
    esp_err_t ret = i2c_master_transmit(dev_handle, buf, len + 1, 100);
    if (ret != ESP_OK) {
        ESP_LOGE(TAG, "Failed to send OLED commands: %s", esp_err_to_name(ret));
    }
}

static void oled_flush_page(uint8_t page) {
    uint8_t cmds[] = {0xB0 + page, 0x00, 0x10};
    oled_send_cmds(cmds, sizeof(cmds));

    uint8_t buf[129];
    buf[0] = 0x40;
    memcpy(buf + 1, fb[page], 128);
    esp_err_t ret = i2c_master_transmit(dev_handle, buf, 129, 100);
    if (ret != ESP_OK) {
        ESP_LOGE(TAG, "Failed to flush OLED page: %s", esp_err_to_name(ret));
    }
    page_dirty[page] = false;
}

void ssd1306_draw_header(const char *title, const char *status) {
    // Page 0 — yellow zone: title left, battery right
    char batt[5];
    uint8_t pct = battery_get_percentage();
    if (pct == BATTERY_INVALID) {
        snprintf(batt, sizeof(batt), " USB");
    } else {
        snprintf(batt, sizeof(batt), "%3u%%", pct);
    }
    ssd1306_draw_string(0, 0, title);
    ssd1306_draw_string(128 - (uint8_t)(strlen(batt) * 8), 0, batt);

    // Page 1 — yellow zone: contextual status left
    if (status && *status) {
        ssd1306_draw_string(0, 1, status);
    }
}

void ssd1306_init(void) {
    i2c_master_bus_config_t i2c_mst_config = {
        .clk_source = I2C_CLK_SRC_DEFAULT,
        .i2c_port = I2C_MASTER_NUM,
        .scl_io_num = I2C_MASTER_SCL_IO,
        .sda_io_num = I2C_MASTER_SDA_IO,
        .glitch_ignore_cnt = 7,
        .flags.enable_internal_pullup = true,
    };

    i2c_master_bus_handle_t bus_handle;
    ESP_ERROR_CHECK(i2c_new_master_bus(&i2c_mst_config, &bus_handle));

    i2c_device_config_t dev_cfg = {
        .dev_addr_length = I2C_ADDR_BIT_LEN_7,
        .device_address = OLED_ADDR,
        .scl_speed_hz = I2C_MASTER_FREQ_HZ,
    };

    ESP_ERROR_CHECK(i2c_master_bus_add_device(bus_handle, &dev_cfg, &dev_handle));

    vTaskDelay(pdMS_TO_TICKS(100));

    static const uint8_t init_cmds[] = {
        0xAE, 0x20, 0x00, 0xB0, 0xC8, 0x00, 0x10, 0x40,
        0x81, 0xFF, 0xA1, 0xA6, 0xA8, 0x3F, 0xA4, 0xD3,
        0x00, 0xD5, 0xF0, 0xD9, 0x22, 0xDA, 0x12, 0xDB,
        0x20, 0x8D, 0x14, 0xAF
    };
    oled_send_cmds(init_cmds, sizeof(init_cmds));
    memset(fb, 0, sizeof(fb));
    memset(page_dirty, true, sizeof(page_dirty));
    ssd1306_flush();
    ESP_LOGI(TAG, "SSD1306 initialized");
}

void ssd1306_clear_buffer(void) {
    memset(fb, 0, sizeof(fb));
    memset(page_dirty, true, sizeof(page_dirty));
}

void ssd1306_clear_screen(void) {
    ssd1306_clear_buffer();
    ssd1306_flush();
}

void ssd1306_clear_page(uint8_t page) {
    if (page >= 8) return;
    memset(fb[page], 0, 128);
    page_dirty[page] = true;
}

void ssd1306_draw_char(uint8_t x, uint8_t page, char c) {
    if (c < 32 || c > 126) c = 32;
    if (x + 8 > 128 || page >= 8) return;
    memcpy(fb[page] + x, font8x8[c - 32], 8);
    page_dirty[page] = true;
}

void ssd1306_draw_string(uint8_t x, uint8_t page, const char *str) {
    while (*str && x + 8 <= 128) {
        ssd1306_draw_char(x, page, *str++);
        x += 8;
    }
}

void ssd1306_draw_bitmap_fullscreen(const uint8_t *bitmap) {
    for (int p = 0; p < 8; p++) {
        for (int x = 0; x < 128; x++) {
            uint8_t val = 0;
            for (int bit = 0; bit < 8; bit++) {
                int row = p * 8 + bit;
                if (bitmap[row * 16 + x / 8] & (0x80 >> (x % 8)))
                    val |= (1 << bit);
            }
            fb[p][x] = val;
        }
        page_dirty[p] = true;
    }
    ssd1306_flush();
}

void ssd1306_fill_rect(uint8_t x, uint8_t y, uint8_t w, uint8_t h) {
    for (uint8_t col = x; col < x + w && col < 128; col++) {
        for (uint8_t row = y; row < y + h && row < 64; row++) {
            fb[row >> 3][col] |= (1u << (row & 7));
            page_dirty[row >> 3] = true;
        }
    }
}

void ssd1306_hline(uint8_t x, uint8_t y, uint8_t w) {
    if (y >= 64) return;
    uint8_t mask = 1u << (y & 7);
    for (uint8_t col = x; col < x + w && col < 128; col++) {
        fb[y >> 3][col] |= mask;
        page_dirty[y >> 3] = true;
    }
}

void ssd1306_invert_rect(uint8_t x, uint8_t y, uint8_t w, uint8_t h) {
    for (uint8_t col = x; col < x + w && col < 128; col++) {
        for (uint8_t row = y; row < y + h && row < 64; row++) {
            fb[row >> 3][col] ^= (1u << (row & 7));
            page_dirty[row >> 3] = true;
        }
    }
}

void ssd1306_flush(void) {
    for (uint8_t p = 0; p < 8; p++) {
        if (page_dirty[p]) {
            oled_flush_page(p);
        }
    }
}
